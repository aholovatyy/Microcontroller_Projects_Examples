
	.DEF _k=R5
	.DEF _PREV_PINF=R4
_98:
	.DB  0xFF
	.DEF _gSelectPlusCounter=R6
	.DEF _gSelectMinusCounter=R8
	.DEF _N=R11
_99:
	.DB  0x1
_100:
	.DB  0x9A,0x99,0xB1,0x41
_101:
	.DB  0xA,0x0
	.DEF _ICR3=R12
	.DEF _ADC_INPUT=R10
_102:
	.DB  0x5
_103:
	.DB  0x5
_104:
	.DB  0x6D
_0x76:
	.DB  0x5E,0x0
	.DB  0x5E,0x0
	.DB  0x5E,0x0
	.DB  0x5E,0x0
	.DB  0x7,0x8
	.DB  0x9,0xB
_0xA8:
	.DB  0x5E,0x0
	.DB  0x5E,0x0
	.DB  0x5E,0x0
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	.DB  0xB
_0xDF:
	.DB  0x5E,0x0
	.DB  0x5E,0x0
	.DB  0x5E,0x0
	.DB  0x7,0x8
	.DB  0x9
_0x137:
	.DB  0x0,0x0
	.DB  0x3,0x3
	.DB  0x1,0x4
	.DB  LOW(_310+0x00),HIGH(_310+0x00)
	.DB  LOW(_310+0x11),HIGH(_310+0x11)
	.DB  LOW(_310+0x22),HIGH(_310+0x22)
	.DB  LOW(_310+0x2D),HIGH(_310+0x2D)
	.DB  LOW(_310+0x38),HIGH(_310+0x38)
	.DB  LOW(_310+0x47),HIGH(_310+0x47)
	.DB  0x0,0x0
__fround_G2:
	.DB  0x0,0x0,0x0,0x3F,0xCD,0xCC,0x4C,0x3D
	.DB  0xA,0xD7,0xA3,0x3B,0x6F,0x12,0x3,0x3A
	.DB  0x17,0xB7,0x51,0x38,0xAC,0xC5,0xA7,0x36
	.DB  0xBD,0x37,0x6,0x35
_633:
	.DW  0x00
_0:
	.DB  0x25,0x75,0x25,0x75,0x25,0x75,0x2E,0x25
	.DB  0x75,0x0,0x25,0x75,0x25,0x75,0x25,0x75
	.DB  0x25,0x75,0x25,0x75,0x0,0x20,0x53,0x45
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	.DB  0x42,0x25,0x75,0x25,0x25,0x0

__GLOBAL_INI_TBL:
	.DW  0x01
	.DW  0x04
	.DW  _98*2

	.DW  0x01
	.DW  0x0B
	.DW  _99*2

	.DW  0x04
	.DW  _fxx
	.DW  _100*2

	.DW  0x02
	.DW  _speed
	.DW  _101*2

	.DW  0x01
	.DW  0x0A
	.DW  _102*2

	.DW  0x01
	.DW  _vref
	.DW  _103*2

	.DW  0x01
	.DW  _od
	.DW  _104*2

	.DW  0x11
	.DW  _310
	.DW  _0*2+0x15

	.DW  0x11
	.DW  _310+0x11
	.DW  _0*2+0x26

	.DW  0x0B
	.DW  _310+0x22
	.DW  _0*2+0x37

	.DW  0x0B
	.DW  _310+0x2D
	.DW  _0*2+0x42

	.DW  0x0F
	.DW  _310+0x38
	.DW  _0*2+0x4D

	.DW  0x09
	.DW  _310+0x47
	.DW  _0*2+0x5C

	.DW  0x02
	.DW  _p_S62
	.DW  _633*2

	.DW  0
_0x29D:
