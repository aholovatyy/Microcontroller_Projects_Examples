
_3:
	.DB  0x17,0x0
_4:
	.DB  0x1B,0x0
_5:
	.DB  0x32,0x0
_6:
	.DB  0x3C,0x0
	.DEF _PREV_BTN_PIN=R5
_7:
	.DB  0xFF
_0x8:
	.DB  0x0,0xB4
	.DB  0xB4,0x0
	.DB  0x78,0x78
	.DB  0x0,0x63
	.DB  0x63,0x0
	.DB  0x5E,0x5E
	.DB  0x0
_0x2E:
	.DB  0xE3,0xE3
	.DB  0x0,0xBC
	.DB  0xBC,0x0
	.DB  0x70,0x70
	.DB  0x0,0x5E
	.DB  0x5E,0x0
_0x58:
	.DB  0x0,0x0
	.DB  0x63,0x0
	.DB  0xA,0x0
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	.DB  0x21,0x0
_0x7D:
	.DB  LOW(_124+0x00),HIGH(_124+0x00)
	.DB  0x0,0x0
	.DB  0x0,LOW(_123+0x00)
	.DB  HIGH(_123+0x00),LOW(_123+0x03)
	.DB  HIGH(_123+0x03),LOW(_123+0x06)
	.DB  HIGH(_123+0x06),LOW(_123+0x09)
	.DB  HIGH(_123+0x09),LOW(_123+0x0C)
	.DB  HIGH(_123+0x0C)
_0xAC:
	.DB  0x2A,0x20
	.DB  0xA1,0x6F
	.DB  0xBB,0x6F
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	.DB  0x0,0x5
	.DB  0x0,LOW(_171+0x00)
	.DB  HIGH(_171+0x00),LOW(_171+0x05)
	.DB  HIGH(_171+0x05),LOW(_171+0x09)
	.DB  HIGH(_171+0x09),LOW(_171+0x0F)
	.DB  HIGH(_171+0x0F),LOW(_171+0x1B)
	.DB  HIGH(_171+0x1B),LOW(_171+0x25)
	.DB  HIGH(_171+0x25),LOW(_171+0x36)
	.DB  HIGH(_171+0x36),LOW(_171+0x41)
	.DB  HIGH(_171+0x41)
_0xC9:
	.DB  LOW(_200+0x00),HIGH(_200+0x00)
	.DB  LOW(_200+0x04),HIGH(_200+0x04)
	.DB  LOW(_200+0x08),HIGH(_200+0x08)
	.DB  LOW(_200+0x0C),HIGH(_200+0x0C)
	.DB  LOW(_200+0x10),HIGH(_200+0x10)
	.DB  LOW(_200+0x14),HIGH(_200+0x14)
	.DB  LOW(_200+0x18),HIGH(_200+0x18)
	.DB  0x0,0x0
	.DB  0x0,0x0
	.DB  0x0,0x0
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	.DB  0x0
_0xEF:
	.DB  0x8,0x0
	.DB  0xC,0x0
	.DB  0xE,0x0
	.DB  0xF,0x0
_C1:
	.DB  0xC5,0xFE,0x2,0xC0
_C2:
	.DB  0xBD,0x52,0x16,0x3F
_C3:
	.DB  0x3B,0x25,0xD6,0xB9
_T1:
	.DB  0xA,0xD7,0x23,0x3C
_T2:
	.DB  0xAC,0xC5,0xA7,0x3A
__fround_G4:
	.DB  0x0,0x0,0x0,0x3F,0xCD,0xCC,0x4C,0x3D
	.DB  0xA,0xD7,0xA3,0x3B,0x6F,0x12,0x3,0x3A
	.DB  0x17,0xB7,0x51,0x38,0xAC,0xC5,0xA7,0x36
	.DB  0xBD,0x37,0x6,0x35
_536:
	.DB  0x80,0xC0
	.DEF __lcd_x=R4
	.DEF __lcd_y=R7
	.DEF __lcd_maxx=R6
_550:
	.DW  0x00
_0:
	.DB  0x25,0x75,0x25,0x75,0x3A,0x25,0x75,0x25
	.DB  0x75,0x3A,0x25,0x75,0x25,0x75,0x20,0x4F
	.DB  0x4B,0x21,0x0,0x20,0x20,0x0,0x25,0x75
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	.DB  0x25,0x75,0x25,0x75,0x20,0x25,0x73,0x0

__GLOBAL_INI_TBL:
	.DW  0x02
	.DW  _0temp
	.DW  _3*2

	.DW  0x02
	.DW  _1temp
	.DW  _4*2

	.DW  0x02
	.DW  _0hum
	.DW  _5*2

	.DW  0x02
	.DW  _1hum
	.DW  _6*2

	.DW  0x01
	.DW  0x05
	.DW  _7*2

	.DW  0x03
	.DW  _123
	.DW  _0*2+0x8D

	.DW  0x03
	.DW  _123+0x03
	.DW  _0*2+0x90

	.DW  0x03
	.DW  _123+0x06
	.DW  _0*2+0x93

	.DW  0x03
	.DW  _123+0x09
	.DW  _0*2+0x96

	.DW  0x03
	.DW  _123+0x0C
	.DW  _0*2+0x96

	.DW  0x04
	.DW  _124
	.DW  _0*2+0x99

	.DW  0x05
	.DW  _171
	.DW  _0*2+0xB6

	.DW  0x04
	.DW  _171+0x05
	.DW  _0*2+0xBB

	.DW  0x06
	.DW  _171+0x09
	.DW  _0*2+0xBF

	.DW  0x0C
	.DW  _171+0x0F
	.DW  _0*2+0xC5

	.DW  0x0A
	.DW  _171+0x1B
	.DW  _0*2+0xD1

	.DW  0x11
	.DW  _171+0x25
	.DW  _0*2+0xDB

	.DW  0x0B
	.DW  _171+0x36
	.DW  _0*2+0xEC

	.DW  0x06
	.DW  _171+0x41
	.DW  _0*2+0xF7

	.DW  0x04
	.DW  _200
	.DW  _0*2+0xFD

	.DW  0x04
	.DW  _200+0x04
	.DW  _0*2+0x101

	.DW  0x04
	.DW  _200+0x08
	.DW  _0*2+0x105

	.DW  0x04
	.DW  _200+0x0C
	.DW  _0*2+0x109

	.DW  0x04
	.DW  _200+0x10
	.DW  _0*2+0x10D

	.DW  0x04
	.DW  _200+0x14
	.DW  _0*2+0x111

	.DW  0x04
	.DW  _200+0x18
	.DW  _0*2+0x115

	.DW  0x02
	.DW  __base_y_G6
	.DW  _536*2

	.DW  0x02
	.DW  _p_S88
	.DW  _550*2

	.DW  0
_0x244:
